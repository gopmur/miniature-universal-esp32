## main/Kconfig
```kconfig
menu "HEXA"

rsource "config/Kconfig.motors" 
rsource "config/Kconfig.imu"
rsource "config/Kconfig.can"
rsource "config/Kconfig.http"
rsource "config/Kconfig.ota"
rsource "config/Kconfig.wifi"
rsource "config/Kconfig.tasks"
rsource "config/Kconfig.sd"

endmenu
```

## main/config/Kconfig.can
```kconfig
menu "CAN"

config HEXA_CAN_COUNT
  int "Number of CAN interfaces"
  range 1 2
  default 2
  help
    Number of supported CAN interfaces

menu "CAN 0"
  depends on HEXA_CAN_COUNT >= 1

config HEXA_CAN_0_FDCAN
  bool "FDCAN"
  default n
  help
    Operate in FDCAN mode

config HEXA_CAN_0_FDCAN_NORMALIZED
  int
  default 1 if HEXA_CAN_0_FDCAN
  default 0

config HEXA_CAN_0_RX_PIN
  int "Rx Pin Number"

config HEXA_CAN_0_TX_PIN
  int "Tx Pin Number"

config HEXA_CAN_0_NOMINAL_BAUDRATE_KHZ
  int "Nominal buadrate (KHz)"

config HEXA_CAN_0_DATA_BAUDRATE_KHZ
  int "Data baudrate (KHz)"
  depends on HEXA_CAN_0_FDCAN

config HEXA_CAN_0_TX_QUEUE_LEN
  int "Transmit Queue Len"
  default 32

config HEXA_CAN_0_NOMINAL_SAMPLE_POINT_PERMILL
  int "Nominal sample point (parts per thousand)"
  range 0 1000

config HEXA_CAN_0_NOMINAL_SECONDARY_SAMPLE_POINT_PERMILL
  int "Nominal secondary sample point (parts per thousand)"
  range 0 1000

config HEXA_CAN_0_DATA_SAMPLE_POINT_PERMILL
  int "Data sample point (parts per thousand)"
  range 0 1000
  depends on HEXA_CAN_0_FDCAN

config HEXA_CAN_0_DATA_SECONDARY_SAMPLE_POINT_PERMILL
  int "Data secondary sample point (parts per thousand)"
  range 0 1000
  depends on HEXA_CAN_0_FDCAN

endmenu

menu "CAN 1"
  depends on HEXA_CAN_COUNT >= 2

config HEXA_CAN_1_FDCAN
  bool "FDCAN"
  default n
  help
    Operate in FDCAN mode

config HEXA_CAN_1_FDCAN_NORMALIZED
  int
  default 1 if HEXA_CAN_1_FDCAN
  default 0

config HEXA_CAN_1_RX_PIN
  int "Rx Pin Number"

config HEXA_CAN_1_TX_PIN
  int "Tx Pin Number"

config HEXA_CAN_1_NOMINAL_BAUDRATE_KHZ
  int "Nominal buadrate (KHz)"

config HEXA_CAN_1_DATA_BAUDRATE_KHZ
  int "Data baudrate (KHz)"
  depends on HEXA_CAN_1_FDCAN

config HEXA_CAN_1_TX_QUEUE_LEN
  int "Transmit Queue Len"
  default 32

config HEXA_CAN_1_NOMINAL_SAMPLE_POINT_PERMILL
  int "Nominal sample point (parts per thousand)"
  range 0 1000

config HEXA_CAN_1_NOMINAL_SECONDARY_SAMPLE_POINT_PERMILL
  int "Nominal secondary sample point (parts per thousand)"
  range 0 1000

config HEXA_CAN_1_DATA_SAMPLE_POINT_PERMILL
  int "Data sample point (parts per thousand)"
  range 0 1000
  depends on HEXA_CAN_1_FDCAN

config HEXA_CAN_1_DATA_SECONDARY_SAMPLE_POINT_PERMILL
  int "Data secondary sample point (parts per thousand)"
  range 0 1000
  depends on HEXA_CAN_1_FDCAN
endmenu

endmenu
```

## main/config/Kconfig.http
```kconfig
menu "HTTP"

config HEXA_HTTP_USE_HTTPS
  bool "Use HTTPS"
  default y
  help
    Enable encryption both for http and websocket

config HEXA_HTTP_MAX_REQUEST_LEN
  int "Max request length"
  range 0 1024
  default 512
  help
    Maximum size of an allowed HTTP request body. Larger request will be ignored
    to prevent heap exhaustion.

config HEXA_HTTP_ALLOW_CORS
  bool "Allow CORS"
  default n
  help
    Enable this if you are hosting the dashboard otherwise keep it disabled.

config HEXA_HTTP_KEEP_ALIVE
  bool "Enable keep alive"
  default y
  help
    Keep the http socket open after a request. (Can break some functionalities best to keep it disabled)

config HEXA_HTTP_MAX_OPEN_SOCKET
  int "Maximum number of open sockets"
  default 16

config HEXA_HTTP_MAX_URI_HANDLER_COUNT
  int "Maximum number of uri handlers"
  default 128

endmenu
```

## main/config/Kconfig.imu
```kconfig
menu "IMU"

config HEXA_IMU_SDA_PIN
  int "SDA pin"
  default 21

config HEXA_IMU_SCL_PIN
  int "SCL pin"
  default 22

choice HEXA_IMU_TYPE
  prompt "type"
  default HEXA_IMU_TYPE_I2C_ICM20948
  help
    Select IMU type

config HEXA_IMU_TYPE_I2C_ICM20948
  bool "icm20948"

config HEXA_IMU_TYPE_MOCK
  bool "mock"

endchoice

config HEXA_IMU_I2C_ICM20948_AD1
  bool "AD1"
  default n
  depends on HEXA_IMU_TYPE_I2C_ICM20948

endmenu
```

## main/config/Kconfig.motors
```kconfig
menu "Motors"

config HEXA_MOTOR_POWER_ENABLE_PIN
  int "Power enable pin"
  help
    GPIO pin of the motors power switch

config HEXA_MOTOR_TIMEOUT_MS
  int "Timeout delay ms"
  default 50
  help 
    Maximum time in milliseconds to wait for a motor response after
    sending a command before marking the motor as disconnected.

config HEXA_MOTOR_COUNT
  int "Number of motors"
  range 1 8
  default 8
  help
    Number of motors in use of the robot

menu "Motor 0"
  depends on HEXA_MOTOR_COUNT >= 1

config HEXA_MOTOR_0_CAN_INTERFACE
  int "CAN interface"
  range 0 1 if HEXA_CAN_COUNT = 2
  range 0 0 if HEXA_CAN_COUNT = 1
  default 0
  help
    The can interface which the motor is connected to

config HEXA_MOTOR_0_ID
  hex "CAN ID"
  range 0x0 0x7FF
  default 0x0
  help
    Unique CAN ID of the motor

choice HEXA_MOTOR_0_TYPE
  prompt "Type"
  default HEXA_MOTOR_0_TYPE_ODRIVE
  help
      Select motor type.

config HEXA_MOTOR_0_TYPE_ODRIVE
  bool "ODrive"

config HEXA_MOTOR_0_TYPE_SMC
  bool "SMC"

config HEXA_MOTOR_0_TYPE_T_MOTOR
  bool "T-Motor"

endchoice

config HEXA_MOTOR_0_RECEIVE_ID
  hex "Receive ID" if HEXA_MOTOR_0_TYPE_T_MOTOR
  range 0x0 0x7FF
  default 0x0
  help
    The CAN ID which the motor uses to send feedbacks

config HEXA_MOTOR_0_BACKWARDS
  bool "Is backwards"
  default n
  help
    If enabled all feedbacks and commands are multiplied by -1

endmenu

menu "Motor 1"
  depends on HEXA_MOTOR_COUNT >= 2

config HEXA_MOTOR_1_CAN_INTERFACE
  int "CAN interface"
  range 0 1 if HEXA_CAN_COUNT = 2
  range 0 0 if HEXA_CAN_COUNT = 1
  default 0
  help
    The can interface which the motor is connected to

config HEXA_MOTOR_1_ID
  hex "CAN ID"
  range 0x0 0x7FF
  default 0x0
  help
    Unique CAN ID of the motor

choice HEXA_MOTOR_1_TYPE
  prompt "Type"
  default HEXA_MOTOR_1_TYPE_ODRIVE
  help
      Select motor type.

config HEXA_MOTOR_1_TYPE_ODRIVE
  bool "ODrive"

config HEXA_MOTOR_1_TYPE_SMC
  bool "SMC"

config HEXA_MOTOR_1_TYPE_T_MOTOR
  bool "T-Motor"

  
endchoice

config HEXA_MOTOR_1_RECEIVE_ID
  hex "Receive ID" if HEXA_MOTOR_1_TYPE_T_MOTOR
  range 0x0 0x7FF
  default 0x0
  help
    The CAN ID which the motor uses to send feedbacks

config HEXA_MOTOR_1_BACKWARDS
  bool "Is backwards"
  default n
  help
    If enabled all feedbacks and commands are multiplied by -1
endmenu

menu "Motor 2"
  depends on HEXA_MOTOR_COUNT >= 3

config HEXA_MOTOR_2_CAN_INTERFACE
  int "CAN interface"
  range 0 1 if HEXA_CAN_COUNT = 2
  range 0 0 if HEXA_CAN_COUNT = 1
  default 0
  help
    The can interface which the motor is connected to

config HEXA_MOTOR_2_ID
  hex "CAN ID"
  range 0x0 0x7FF
  default 0x0
  help
    Unique CAN ID of the motor

choice HEXA_MOTOR_2_TYPE
  prompt "Type"
  default HEXA_MOTOR_2_TYPE_ODRIVE
  help
      Select motor type.

config HEXA_MOTOR_2_TYPE_ODRIVE
  bool "ODrive"

config HEXA_MOTOR_2_TYPE_SMC
  bool "SMC"

config HEXA_MOTOR_2_TYPE_T_MOTOR
  bool "T-Motor"


endchoice

config HEXA_MOTOR_2_RECEIVE_ID
  hex "Receive ID" if HEXA_MOTOR_2_TYPE_T_MOTOR
  range 0x0 0x7FF
  default 0x0
  help
    The CAN ID which the motor uses to send feedbacks

config HEXA_MOTOR_2_BACKWARDS
  bool "Is backwards"
  default n
  help
    If enabled all feedbacks and commands are multiplied by -1

endmenu

menu "Motor 3"
  depends on HEXA_MOTOR_COUNT >= 4

config HEXA_MOTOR_3_CAN_INTERFACE
  int "CAN interface"
  range 0 1 if HEXA_CAN_COUNT = 2
  range 0 0 if HEXA_CAN_COUNT = 1
  default 0
  help
    The can interface which the motor is connected to

config HEXA_MOTOR_3_ID
  hex "CAN ID"
  range 0x0 0x7FF
  default 0x0
  help
    Unique CAN ID of the motor

choice HEXA_MOTOR_3_TYPE
  prompt "Type"
  default HEXA_MOTOR_3_TYPE_ODRIVE
  help
      Select motor type.

config HEXA_MOTOR_3_TYPE_ODRIVE
  bool "ODrive"

config HEXA_MOTOR_3_TYPE_SMC
  bool "SMC"

config HEXA_MOTOR_3_TYPE_T_MOTOR
  bool "T-Motor"


endchoice

config HEXA_MOTOR_3_RECEIVE_ID
  hex "Receive ID" if HEXA_MOTOR_3_TYPE_T_MOTOR
  range 0x0 0x7FF
  default 0x0
  help
    The CAN ID which the motor uses to send feedbacks

config HEXA_MOTOR_3_BACKWARDS
  bool "Is backwards"
  default n
  help
    If enabled all feedbacks and commands are multiplied by -1

endmenu

menu "Motor 4"
  depends on HEXA_MOTOR_COUNT >= 5

config HEXA_MOTOR_4_CAN_INTERFACE
  int "CAN interface"
  range 0 1 if HEXA_CAN_COUNT = 2
  range 0 0 if HEXA_CAN_COUNT = 1
  default 0
  help
    The can interface which the motor is connected to

config HEXA_MOTOR_4_ID
  hex "CAN ID"
  range 0x0 0x7FF
  default 0x0
  help
    Unique CAN ID of the motor

choice HEXA_MOTOR_4_TYPE
  prompt "Type"
  default HEXA_MOTOR_4_TYPE_ODRIVE
  help
      Select motor type.

config HEXA_MOTOR_4_TYPE_ODRIVE
  bool "ODrive"

config HEXA_MOTOR_4_TYPE_SMC
  bool "SMC"

config HEXA_MOTOR_4_TYPE_T_MOTOR
  bool "T-Motor"


endchoice

config HEXA_MOTOR_4_RECEIVE_ID
  hex "Receive ID" if HEXA_MOTOR_4_TYPE_T_MOTOR
  range 0x0 0x7FF
  default 0x0
  help
    The CAN ID which the motor uses to send feedbacks

config HEXA_MOTOR_4_BACKWARDS
  bool "Is backwards"
  default n
  help
    If enabled all feedbacks and commands are multiplied by -1

endmenu

menu "Motor 5"
  depends on HEXA_MOTOR_COUNT >= 6

config HEXA_MOTOR_5_CAN_INTERFACE
  int "CAN interface"
  range 0 1 if HEXA_CAN_COUNT = 2
  range 0 0 if HEXA_CAN_COUNT = 1
  default 0
  help
    The can interface which the motor is connected to

config HEXA_MOTOR_5_ID
  hex "CAN ID"
  range 0x0 0x7FF
  default 0x0
  help
    Unique CAN ID of the motor

choice HEXA_MOTOR_5_TYPE
  prompt "Type"
  default HEXA_MOTOR_5_TYPE_ODRIVE
  help
      Select motor type.

config HEXA_MOTOR_5_TYPE_ODRIVE
  bool "ODrive"

config HEXA_MOTOR_5_TYPE_SMC
  bool "SMC"

config HEXA_MOTOR_5_TYPE_T_MOTOR
  bool "T-Motor"


endchoice

config HEXA_MOTOR_5_RECEIVE_ID
  hex "Receive ID" if HEXA_MOTOR_5_TYPE_T_MOTOR
  range 0x0 0x7FF
  default 0x0
  help
    The CAN ID which the motor uses to send feedbacks

config HEXA_MOTOR_5_BACKWARDS
  bool "Is backwards"
  default n
  help
    If enabled all feedbacks and commands are multiplied by -1

endmenu

menu "Motor 6"
  depends on HEXA_MOTOR_COUNT >= 7

config HEXA_MOTOR_6_CAN_INTERFACE
  int "CAN interface"
  range 0 1 if HEXA_CAN_COUNT = 2
  range 0 0 if HEXA_CAN_COUNT = 1
  default 0
  help
    The can interface which the motor is connected to

config HEXA_MOTOR_6_ID
  hex "CAN ID"
  range 0x0 0x7FF
  default 0x0
  help
    Unique CAN ID of the motor

choice HEXA_MOTOR_6_TYPE
  prompt "Type"
  default HEXA_MOTOR_6_TYPE_ODRIVE
  help
      Select motor type.

config HEXA_MOTOR_6_TYPE_ODRIVE
  bool "ODrive"

config HEXA_MOTOR_6_TYPE_SMC
  bool "SMC"

config HEXA_MOTOR_6_TYPE_T_MOTOR
  bool "T-Motor"


endchoice

config HEXA_MOTOR_6_RECEIVE_ID
  hex "Receive ID" if HEXA_MOTOR_6_TYPE_T_MOTOR
  range 0x0 0x7FF
  default 0x0
  help
    The CAN ID which the motor uses to send feedbacks

config HEXA_MOTOR_6_BACKWARDS
  bool "Is backwards"
  default n
  help
    If enabled all feedbacks and commands are multiplied by -1

endmenu

menu "Motor 7"
  depends on HEXA_MOTOR_COUNT >= 8

config HEXA_MOTOR_7_CAN_INTERFACE
  int "CAN interface"
  range 0 1 if HEXA_CAN_COUNT = 2
  range 0 0 if HEXA_CAN_COUNT = 1
  default 0
  help
    The can interface which the motor is connected to

config HEXA_MOTOR_7_ID
  hex "CAN ID"
  range 0x0 0x7FF
  default 0x0
  help
    Unique CAN ID of the motor

choice HEXA_MOTOR_7_TYPE
  prompt "Type"
  default HEXA_MOTOR_7_TYPE_ODRIVE
  help
      Select motor type.

config HEXA_MOTOR_7_TYPE_ODRIVE
  bool "ODrive"

config HEXA_MOTOR_7_TYPE_SMC
  bool "SMC"

config HEXA_MOTOR_7_TYPE_T_MOTOR
  bool "T-Motor"


endchoice

config HEXA_MOTOR_7_RECEIVE_ID
  hex "Receive ID" if HEXA_MOTOR_7_TYPE_T_MOTOR
  range 0x0 0x7FF
  default 0x0
  help
    The CAN ID which the motor uses to send feedbacks

config HEXA_MOTOR_7_BACKWARDS
  bool "Is backwards"
  default n
  help
    If enabled all feedbacks and commands are multiplied by -1

endmenu

endmenu
```

## main/config/Kconfig.ota
```kconfig
menu "OTA"

config HEXA_OTA_SERVER_ADDRESS
  string "Server Address"
  default "eps32.scofield1.ir"
  help
    Address of the update server

endmenu
```

## main/config/Kconfig.sd
```kconfig
menu "SD Card"

config HEXA_SD_CARD_CS_PIN
  int "CS ping"
  default 5

config HEXA_SD_CARD_MOSI_PIN
  int "MOSI pin"
  default 23

config HEXA_SD_CARD_MISO_PIN
  int "MISO pin"
  default 19

config HEXA_SD_CARD_SCLK_PIN
  int "SCLK pin" 
  default 18

endmenu
```

## main/config/Kconfig.tasks
```kconfig
menu "Tasks"

menu "DNS"

config HEXA_TASKS_DNS_PRIORITY
  int "Priority"
  default 18

config HEXA_TASKS_DNS_STACK_SIZE
  int "Stack Size"
  default 4096

config HEXA_TASKS_DNS_NAME_SIZE
  string "Domain Name"
  default "hexa.lan"

endmenu

menu "WebSocket"

config HEXA_TASKS_WS_PRIORITY
  int "Priority"
  default 2

config HEXA_TASKS_WS_STACK_SIZE
  int "Stack Size"
  default 4096

config HEXA_TASKS_WS_FREQ_HZ
  int "Frequency (Hz)"
  default 33

endmenu

menu "IMU"

config HEXA_TASKS_IMU_PRIORITY
  int "Priority"
  default 2

config HEXA_TASKS_IMU_STACK_SIZE
  int "Stack Size"
  default 4096

config HEXA_TASKS_IMU_FREQ_HZ
  int "Frequency (Hz)"
  default 200

endmenu

menu "Control"

config HEXA_TASKS_CONTROL_PRIORITY
  int "Priority"
  default 2

config HEXA_TASKS_CONTROL_STACK_SIZE
  int "Stack size"
  default 4096

config HEXA_TASKS_CONTROL_FREQ_HZ
  int "Frequency (Hz)"
  default 100

endmenu

menu "Motor"

config HEXA_TASKS_MOTOR_PRIORITY
  int "Priority"
  default 18

config HEXA_TASKS_MOTOR_STACK_SIZE
  int "Stack size"
  default 4096

config HEXA_TASKS_MOTOR_FREQ_HZ
  int "Frequency (Hz)"
  default 100

endmenu

menu "Can recv"

config HEXA_TASKS_CAN_RECV_PRIORITY
  int "Priority"
  default 18

config HEXA_TASKS_CAN_RECV_STACK_SIZE
  int "Stack size"
  default 4096

endmenu

menu "Logger"

config HEXA_TASKS_LOGGER_PRIORITY
  int "Priority"
  default 18

config HEXA_TASKS_LOGGER_STACK_SIZE
  int "Stack size"
  default 4096

config HEXA_TASKS_LOGGER_FREQ_HZ
  int "Frequency (Hz)"
  default 33

endmenu

menu "Monitor"

config HEXA_TASKS_MONITOR_PRIORITY
  int "Priority"
  default 18

config HEXA_TASKS_MONITOR_STACK_SIZE
  int "Stack size"
  default 4096

config HEXA_TASKS_MONITOR_FREQ_MS
  int "Period (ms)"
  default 1000

endmenu

endmenu
```

## main/config/Kconfig.wifi
```kconfig
menu "WiFi"

config HEXA_WIFI_SSID
  string "SSID"
  default "Mini Universal"

config HEXA_WIFI_PASSWORD
  string "Password"
  default "12345678"

config HEXA_WIFI_MAX_CONNECTIONS
  int "Max Connections"
  default 3

endmenu
```
